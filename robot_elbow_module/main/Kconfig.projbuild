## robot_elbow_module/main/Kconfig.projbuild
```kconfig
mainmenu "Robot elbow module"
    menu "LIMB config"
        config IMU_ENABLED
            bool "Enable IMU"
            default n
            help
                Enable IMU telemetry when an external IMU is wired to assigned
                SDA and SCL GPIOs. The elbow V3.0 board has no assigned I2C pins.
        config FORCE_REENABLE_CAN_ON_BUS_OFF
            bool "Force reenable CAN on bus off"
            default n
            help
                This option force reenables CAN if it enters a bus off state. WARNING: This might cause CAN messages
                to be starved! A bus off event means that a bunch of errors have happened, so forcing it to be reenabled
                might flood the bus with error frames.
    endmenu
```

## robot_elbow_module/sdkconfig.defaults
```kconfig
CONFIG_FREERTOS_HZ=1000
CONFIG_ESP_SYSTEM_PANIC_REBOOT_DELAY_SECONDS=1
CONFIG_ESPTOOLPY_FLASHSIZE_4MB=y
```

## robot_shoulder_module/sdkconfig.defaults
```kconfig
CONFIG_IDF_TARGET="esp32"
CONFIG_FREERTOS_HZ=1000
CONFIG_ESP_SYSTEM_PANIC_REBOOT_DELAY_SECONDS=1
CONFIG_ESPTOOLPY_FLASHSIZE_4MB=y
```
